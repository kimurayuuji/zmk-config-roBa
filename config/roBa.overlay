#include <input/processors.dtsi>
#include <dt-bindings/zmk/input_transform.h>


&trackball_listener {
    input-processors = <&zip_xy_scaler 3 2>;
    scroller {
        input-processors = <
            &zip_xy_to_scroll_mapper
            &zip_scroll_transform (INPUT_TRANSFORM_X_INVERT | INPUT_TRANSFORM_Y_INVERT)
        >;
    };
};

